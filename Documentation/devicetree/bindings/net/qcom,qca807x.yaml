## Documentation/devicetree/bindings/net/qcom,qca807x.yaml
```yaml
# SPDX-License-Identifier: (GPL-2.0-only OR BSD-2-Clause)
%YAML 1.2
---
$id: http://devicetree.org/schemas/net/qcom,qca807x.yaml#
$schema: http://devicetree.org/meta-schemas/core.yaml#

title: Qualcomm QCA807x PHY

maintainers:
  - Robert Marko <robert.marko@sartura.hr>

description: |
  Bindings for Qualcomm QCA807x PHYs

allOf:
  - $ref: ethernet-phy.yaml#

properties:
  reg:
    maxItems: 1

  qcom,fiber-enable:
    description: |
      If present, then PHYs combo port is configured to operate in combo
      mode. In combo mode autodetection of copper and fiber media is
      used in order to support both of them.
      Combo mode can be strapped as well, if not strapped this property
      will set combo support anyway.
    type: boolean

  qcom,psgmii-az:
    description: |
      If present, then PSMGII PHY will advertise 802.3-az support to
      the MAC.
    type: boolean

  gpio-controller: true
  "#gpio-cells":
    const: 2

  qcom,tx-driver-strength:
    description: PSGMII/QSGMII SerDes TX driver strength control in mV.
    $ref: /schemas/types.yaml#/definitions/uint32
    enum: [140, 160, 180, 200, 220, 240, 260, 280, 300, 320, 400, 500, 600]

  qcom,control-dac:
    description: Analog MDI driver amplitude and bias current.
    $ref: /schemas/types.yaml#/definitions/uint32
    enum: [0, 1, 2, 3, 4, 5, 6, 7]

required:
  - reg

unevaluatedProperties: false

examples:
  - |
    #include <dt-bindings/net/qcom-qca807x.h>

    mdio {
      #address-cells = <1>;
      #size-cells = <0>;

      ethphy0: ethernet-phy@0 {
        compatible = "ethernet-phy-ieee802.3-c22";
        reg = <0>;

        qcom,control-dac = <QCA807X_CONTROL_DAC_DSP_VOLT_QUARTER_BIAS>;
      };
    };
```

## drivers/net/dsa/qca/Kconfig
```kconfig
# SPDX-License-Identifier: GPL-2.0-only
config NET_DSA_AR9331
	tristate "Qualcomm Atheros AR9331 Ethernet switch support"
	depends on NET_DSA
	select NET_DSA_TAG_AR9331
	select REGMAP
	help
	  This enables support for the Qualcomm Atheros AR9331 built-in Ethernet
	  switch.

config NET_DSA_IPQ40XX_QCA8K
	tristate "Qualcomm Atheros QCA8K Ethernet switch in IPQ40xx SoC-s support"
	depends on NET_DSA
	select REGMAP
	help
	  This enables support for the Qualcomm Atheros QCA8K Ethernet
	  switch chips in IPQ40xx SoC-s.

choice
	prompt "IPQ40xx switch tagging protocol"
	depends on NET_DSA_IPQ40XX_QCA8K
	default NET_DSA_IPQ40XX_TAG_INBAND

config NET_DSA_IPQ40XX_TAG_INBAND
	bool "Use in-band tags"
	select NET_DSA_TAG_IPQ40XX_IB

config NET_DSA_IPQ40XX_TAG_SKB_EXT
	bool "Use skb extension based tags"
	select NET_DSA_TAG_IPQ40XX

endchoice
```

## drivers/soc/delta/Kconfig
```kconfig
# SPDX-License-Identifier: GPL-2.0-only
#
# Delta Networks CPLD debug drivers
#
menu "Delta Networks CPLD debug drivers"

config DELTA_CPLDINFO
	tristate "Delta Networks CPLD debug driver"
	depends on MFD_TN48M_CPLD || COMPILE_TEST
	help
	  This driver exposes board specific HW information, CPLD
	  software information, various PSU related information and
	  LED testing capabilities provided by the onboard CPLD.

endmenu
```
